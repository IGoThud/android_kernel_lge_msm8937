## drivers/input/touchscreen/lge/synaptics/Kconfig
```kconfig
#
# LGE touch core configuration
#

if INPUT_TOUCHSCREEN

menuconfig LGE_TOUCH_SYNAPTICS_S3330
	bool "LGE Touch Core ODM Device Driver - Synaptics(s3330)"
	depends on LGE_TOUCH_CORE_BASE
	help
	  If your device is synaptics(s3330), say Y

endif
```
